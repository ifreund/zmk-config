## config/west.yml
```yaml
manifest:
  remotes:
    - name: ifreund
      url-base: https://github.com/ifreund
  projects:
    - name: zmk
      remote: ifreund
      revision: personal
      import: app/west.yml
  self:
    path: config
```
